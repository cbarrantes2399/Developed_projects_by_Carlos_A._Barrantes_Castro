## Embedded_systems/Proyecto_2_TSE/conf/bblayers.conf
```bitbake
# POKY_BBLAYERS_CONF_VERSION is increased each time build/conf/bblayers.conf
# changes incompatibly
POKY_BBLAYERS_CONF_VERSION = "2"

BBPATH = "${TOPDIR}"
BBFILES ?= ""

BBLAYERS ?= " \
  /home/mac/Proyecto_2_embebidos/poky/meta \
  /home/mac/Proyecto_2_embebidos/poky/meta-poky \
  /home/mac/Proyecto_2_embebidos/poky/meta-yocto-bsp \
  /home/mac/Proyecto_2_embebidos/poky/meta-raspberrypi \
  /home/mac/Proyecto_2_embebidos/poky/meta-openembedded/meta-oe \
  /home/mac/Proyecto_2_embebidos/poky/meta-openembedded/meta-python \
  /home/mac/Proyecto_2_embebidos/poky/meta-tensorflow-lite \
  /home/mac/Proyecto_2_embebidos/poky/meta-archivos \
  "
```
